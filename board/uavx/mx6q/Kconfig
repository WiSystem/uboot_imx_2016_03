## board/uavx/mx6q/Kconfig
```kconfig
if TARGET_MX6Q_UAVX_35i00

config SYS_BOARD
	default "mx6q"

config SYS_VENDOR
	default "uavx"

config SYS_CONFIG_NAME
	default "mx6q_uavx_35i00"

endif
```

## board/uavx/mx6q_pop/Kconfig
```kconfig
if TARGET_MX6Q_UAVX_37i00

config SYS_BOARD
	default "mx6q_pop"

config SYS_VENDOR
	default "uavx"

config SYS_CONFIG_NAME
	default "mx6q_uavx_37i00"

endif
```

## configs/mx6q_uavx_35i00_defconfig
```kconfig
CONFIG_ARM=y
CONFIG_ARCH_MX6=y
CONFIG_TARGET_MX6Q_UAVX_35i00=y
CONFIG_SYS_EXTRA_OPTIONS="IMX_CONFIG=board/uavx/mx6q/mx6q_4x_mt41j256.cfg,MX6Q,DDR_SIZE=SZ_2G"
# CONFIG_CMD_IMLS is not set
# CONFIG_CMD_FLASH is not set
CONFIG_SPI_FLASH=y
CONFIG_SYS_PROMPT="UAVX U-Boot> "
```

## configs/mx6q_uavx_37i00_defconfig
```kconfig
CONFIG_ARM=y
CONFIG_ARCH_MX6=y
CONFIG_TARGET_MX6Q_UAVX_37i00=y
CONFIG_SYS_EXTRA_OPTIONS="IMX_CONFIG=board/uavx/mx6q_pop/ddr_1G.cfg,MX6Q,MX6DQ_POP_LPDDR2,LPDDR2_1G,DDR_MB=512,DDR_SIZE=SZ_1G"
#CONFIG_SYS_EXTRA_OPTIONS="IMX_CONFIG=board/uavx/mx6q_pop/ddr_512M.cfg,MX6Q,MX6DQ_POP_LPDDR2,LPDDR2_512MB,DDR_MB=512,DDR_SIZE=SZ_512M"
CONFIG_SPI_FLASH=y
CONFIG_CMD_GPIO=y
CONFIG_SYS_PROMPT="UAVX U-Boot> "
```
